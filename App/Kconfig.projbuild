## App/Kconfig.projbuild
```kconfig
menu "NETWORK PROBE network"

    config NETWORK_PROBE_WIFI_SSID
        string "Default Wi-Fi SSID"
        default ""
        help
            Network to join until one is saved on the setup page; the first one saved replaces it. Leave empty to start
            in setup mode. Put real credentials in sdkconfig.local (git-ignored), not in
            sdkconfig.defaults.

    config NETWORK_PROBE_WIFI_PASSWORD
        string "Default Wi-Fi password"
        default ""

    config NETWORK_PROBE_WIFI_STA_TIMEOUT_MS
        int "Station connect timeout at boot before setup mode (ms)"
        range 1000 120000
        default 15000

    config NETWORK_PROBE_AP_PASSWORD
        string "Setup access point password"
        default ""
        help
            WPA2 password, at least 8 characters. Anything shorter starts an OPEN
            access point. The access point is named after the device id,
            network-probe-xxxxxx.

    config NETWORK_PROBE_AP_CHANNEL
        int "Setup access point channel"
        range 1 13
        default 6
        help
            Once the station joins a network, the access point moves to the channel
            of that network.

    config NETWORK_PROBE_SETUP_BUTTON_GPIO
        int "Setup button GPIO (-1 = none)"
        range -1 48
        default 0
        help
            Active low, with the internal pull-up. Holding it for 3 s while the probe
            runs forgets the saved networks and restarts the probe. The default GPIO0
            is the BOOT button of the Waveshare ESP32-S3-Pico.

    config NETWORK_PROBE_PORT
        int "NETWORK PROBE protocol TCP port (MCUViewer)"
        range 1 65535
        default 2023
        help
            Port of the NETWORK PROBE protocol server. MCUViewer connects here.
            Announced over mDNS as _network-probe._tcp.

    config NETWORK_PROBE_STREAM_BUFFER_KB
        int "Streaming sample buffer (KiB)"
        range 16 1536
        default 1024
        help
            Ring buffer between sampling and the network, in PSRAM. It bridges
            Wi-Fi stalls: at 48 bytes per sample and 3 kHz, 1 MiB holds about 7 s.
            Without PSRAM a 32 KiB buffer in internal RAM is used.

endmenu

menu "NETWORK PROBE SWO"

    config NETWORK_PROBE_SWO_GPIO
        int "SWO GPIO (-1 = no SWO)"
        range -1 48
        default 6
        help
            Input for the target's SWO pin, received in NRZ (UART) encoding by UART1
            with DMA, up to 5 MBaud. UART1 reaches the pin through the GPIO matrix, so
            any free GPIO works. The internal pull-up keeps the line idle while the
            target does not drive it.

    config NETWORK_PROBE_SWO_BUFFER_KB
        int "SWO buffer (KiB)"
        range 16 1024
        default 256
        help
            Buffer between the SWO receiver and the network, in PSRAM, rounded down
            to a power of two. It bridges Wi-Fi stalls: at 2 MBaud (200 kB/s) 256 KiB
            holds about 1.3 s. Without PSRAM a 16 KiB buffer in internal RAM is used.

endmenu

menu "NETWORK PROBE status LED"

    config NETWORK_PROBE_LED_GPIO
        int "Status LED GPIO (-1 = none)"
        range -1 48
        default 21
        help
            Data input of a WS2812 RGB LED, driven by RMT. It shows the network, the
            MCUViewer or GDB session, the traffic and errors. The default GPIO21 is
            the RGB LED of the Waveshare ESP32-S3-Pico.

    config NETWORK_PROBE_LED_BRIGHTNESS
        int "Status LED brightness"
        range 1 255
        default 48
        help
            Full scale of every color. A WS2812 at 255 is glaring on a desk.

    choice NETWORK_PROBE_LED_ORDER
        prompt "Status LED color order"
        default NETWORK_PROBE_LED_ORDER_RGB
        help
            Byte order the LED expects. If red shows as green, pick the other one.

        config NETWORK_PROBE_LED_ORDER_RGB
            bool "RGB (Waveshare ESP32-S3-Pico)"

        config NETWORK_PROBE_LED_ORDER_GRB
            bool "GRB (most WS2812)"

    endchoice

endmenu
```

## Platform/Kconfig
```kconfig
menu "NETWORK PROBE SWD / Black Magic Debug port"

    config NETWORK_PROBE_SWCLK_GPIO
        int "SWCLK GPIO"
        range 0 31
        default 5
        help
            GPIO driving SWCLK. Must be below 32, because the line is enabled through
            GPIO_ENABLE_W1TS/W1TC.

    config NETWORK_PROBE_SWDIO_GPIO
        int "SWDIO GPIO"
        range 0 31
        default 4
        help
            GPIO for SWDIO. Must be below 32, because the line direction is switched
            through GPIO_ENABLE_W1TS/W1TC.

    config NETWORK_PROBE_NRST_GPIO
        int "Target nRST GPIO (-1 = not connected)"
        range -1 48
        default 10
        help
            Open-drain output with internal pull-up.

    config NETWORK_PROBE_SWD_FREQ_HZ
        int "Default SWD clock frequency (Hz)"
        range 10000 40000000
        default 4000000
        help
            Requested SWCLK frequency at boot. Can be changed at runtime with
            "monitor frequency". The achievable maximum is limited by the bit-bang loop
            and logged at boot.

    config NETWORK_PROBE_GDB_PORT
        int "GDB server TCP port"
        range 1 65535
        default 2022

    config NETWORK_PROBE_BMD_DEBUG
        bool "Enable Black Magic Debug debug output on the console"
        default n

endmenu
```

## Tools/espnow_bench/main/Kconfig.projbuild
```kconfig
menu "ESP-NOW bench"

    config ESPNOW_BENCH_CHANNEL
        int "Channel"
        range 1 13
        default 6
        help
            Channel the initiator runs on when it joins no network. A board that waits for an initiator
            hops through the channels until one finds it.

    config ESPNOW_BENCH_WINDOW
        int "Frames in flight"
        range 1 8
        default 2
        help
            Frames handed to ESP-NOW before the send callback of the first one came. Espressif recommends
            waiting for each callback, which is 1.

    config ESPNOW_BENCH_STREAM_MS
        int "Throughput test duration (ms)"
        range 500 10000
        default 2000

    config ESPNOW_BENCH_WIFI_SSID
        string "Wi-Fi network for the station test"
        default ""
        help
            With a network set, the initiator joins it before the tests, so they run on the network's
            channel next to a station link, like a probe on Wi-Fi with a dongle. Put real credentials in
            sdkconfig.local (git-ignored).

    config ESPNOW_BENCH_WIFI_PASSWORD
        string "Wi-Fi password"
        default ""

    config ESPNOW_BENCH_BUTTON_GPIO
        int "Start button GPIO"
        range 0 48
        default 0
        help
            Active low, with the internal pull-up. A press makes this board the initiator. The default GPIO0
            is the BOOT button.

endmenu
```

## Tools/wifi_dongle/main/Kconfig.projbuild
```kconfig
menu "Wi-Fi dongle"

    config DONGLE_WIFI_SSID
        string "Network to join (empty: the nearest probe)"
        default ""
        help
            Empty joins the strongest probe access point in range, network-probe-xxxxxx. Name a network
            to join that one instead, for example one probe's access point.

    config DONGLE_WIFI_PASSWORD
        string "Network password"
        default ""
        help
            A probe's access point is open unless CONFIG_NETWORK_PROBE_AP_PASSWORD is set on the probe.
            Put a real password in sdkconfig.local (git-ignored).

    config DONGLE_LED_GPIO
        int "Status LED GPIO (-1 = none)"
        range -1 48
        default 21
        help
            Data input of a WS2812 RGB LED. The default GPIO21 is the RGB LED of the Waveshare
            ESP32-S3-Pico.

    choice DONGLE_LED_ORDER
        prompt "Status LED color order"
        default DONGLE_LED_ORDER_RGB
        help
            Byte order the LED expects. If red shows as green, pick the other one.

        config DONGLE_LED_ORDER_RGB
            bool "RGB (Waveshare ESP32-S3-Pico)"

        config DONGLE_LED_ORDER_GRB
            bool "GRB (most WS2812)"

    endchoice

endmenu
```

## dongle/main/Kconfig.projbuild
```kconfig
menu "NETWORK PROBE dongle"

    config DONGLE_CHANNEL
        int "Wi-Fi channel"
        range 1 13
        default 6
        help
            ESP-NOW channel. A probe talks on the channel its radio is on: the channel of the network it
            joined, or in setup mode the channel of its access point, 6 by default.

    config DONGLE_LED_GPIO
        int "Status LED GPIO (-1 = none)"
        range -1 48
        default 21
        help
            Data input of a WS2812 RGB LED. The default GPIO21 is the RGB LED of the Waveshare
            ESP32-S3-Pico.

    choice DONGLE_LED_ORDER
        prompt "Status LED color order"
        default DONGLE_LED_ORDER_RGB
        help
            Byte order the LED expects. If red shows as green, pick the other one.

        config DONGLE_LED_ORDER_RGB
            bool "RGB (Waveshare ESP32-S3-Pico)"

        config DONGLE_LED_ORDER_GRB
            bool "GRB (most WS2812)"

    endchoice

endmenu
```

## firmware/components/bmd/Kconfig
```kconfig
menu "MVProbe SWD / Black Magic Debug port"

    config MVPROBE_SWCLK_GPIO
        int "SWCLK GPIO"
        range 0 31
        default 12
        help
            GPIO driving SWCLK. Must be below 32. The default GPIO12 is header pin GP1
            (physical pin 2) on the Waveshare ESP32-S3-Pico, and is also the FSPICLK
            IO_MUX pin, which keeps an SPI-based SWD implementation possible later.

    config MVPROBE_SWDIO_GPIO
        int "SWDIO GPIO"
        range 0 31
        default 11
        help
            GPIO for SWDIO. Must be below 32, because the line direction is switched
            through GPIO_ENABLE_W1TS/W1TC. The default GPIO11 is header pin GP0
            (physical pin 1) on the Waveshare ESP32-S3-Pico, and is also the FSPID
            IO_MUX pin.

    config MVPROBE_NRST_GPIO
        int "Target nRST GPIO (-1 = not connected)"
        range -1 48
        default 14
        help
            Open-drain output with internal pull-up. The default GPIO14 is header pin GP3
            (physical pin 5) on the Waveshare ESP32-S3-Pico. GPIO13 (GP2) is left free
            on purpose: it is the FSPIQ IO_MUX pin.

    config MVPROBE_SWD_FREQ_HZ
        int "Default SWD clock frequency (Hz)"
        range 10000 40000000
        default 4000000
        help
            Requested SWCLK frequency at boot. Can be changed at runtime with
            "monitor frequency". The achievable maximum is limited by the bit-bang loop;
            "monitor swd_info" reports the measured clock.

    config MVPROBE_GDB_PORT
        int "GDB server TCP port"
        range 1 65535
        default 2022

    config MVPROBE_BMD_DEBUG
        bool "Enable Black Magic Debug debug output on the console"
        default n

endmenu
```

## firmware/main/Kconfig.projbuild
```kconfig
menu "MVProbe network"

    config MVPROBE_WIFI_SSID
        string "Wi-Fi SSID (station mode)"
        default ""
        help
            Network to join. Leave empty to always start the fallback access point.
            Put real credentials in firmware/sdkconfig.local (git-ignored), not in
            sdkconfig.defaults.

    config MVPROBE_WIFI_PASSWORD
        string "Wi-Fi password (station mode)"
        default ""

    config MVPROBE_WIFI_STA_TIMEOUT_MS
        int "Station connect timeout before AP fallback (ms)"
        range 1000 120000
        default 15000

    config MVPROBE_AP_SSID
        string "Fallback access point SSID"
        default "mvprobe"

    config MVPROBE_AP_PASSWORD
        string "Fallback access point password"
        default ""
        help
            WPA2 password, at least 8 characters. Anything shorter starts an OPEN
            access point.

    config MVPROBE_AP_CHANNEL
        int "Fallback access point channel"
        range 1 13
        default 6

    config MVPROBE_HOSTNAME
        string "Hostname (DHCP and mDNS)"
        default "mvprobe"

endmenu
```
