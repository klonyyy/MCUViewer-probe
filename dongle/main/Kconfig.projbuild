## dongle/main/Kconfig.projbuild
```kconfig
menu "NETWORK PROBE dongle"

    config DONGLE_COUNTRY
        string "Wi-Fi country code"
        default "01"
        help
            Sets the channels the dongle looks for probes on. A probe talks on the channel its radio is
            on: the channel of the network it joined, or in setup mode the channel of its access point.
            "01", the world-safe default, allows channels 1 to 11. To reach probes on networks on
            channels 12 and 13, set the country you are in, where it allows them, for example "PL" or
            "DE"; see esp_wifi_set_country_code() for the codes ESP-IDF knows.

    config DONGLE_LED_GPIO
        int "Status LED GPIO (-1 = none)"
        range -1 48
        default 21
        help
            Data input of a WS2812 RGB LED. The default GPIO21 is the RGB LED of the Waveshare
            ESP32-S3-Pico.

    choice DONGLE_LED_ORDER
        prompt "Status LED color order"
        default DONGLE_LED_ORDER_RGB
        help
            Byte order the LED expects. If red shows as green, pick the other one.

        config DONGLE_LED_ORDER_RGB
            bool "RGB (Waveshare ESP32-S3-Pico)"

        config DONGLE_LED_ORDER_GRB
            bool "GRB (most WS2812)"

    endchoice

endmenu
```
